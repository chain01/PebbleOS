## boards/sf32lb52_ulp/Kconfig
```kconfig
# SPDX-FileCopyrightText: 2026 Core Devices LLC
# SPDX-License-Identifier: Apache-2.0

config BOARD_SF32LB52_ULP
    bool
    default y
```

## src/fw/drivers/battery/Kconfig
```kconfig
# SPDX-FileCopyrightText: 2026 Core Devices LLC
# SPDX-License-Identifier: Apache-2.0

menuconfig BATTERY
    bool "Battery"
    help
      Battery Drivers

if BATTERY

config BATTERY_PMIC
    bool "PMIC-based"
    help
      Battery management via external PMIC. Used on platforms where the
      PMIC handles battery monitoring (asterix, obelix, getafix).

config BATTERY_AW32001
    bool "AW32001 charger and battery ADC"
    depends on I2C
    depends on SOC_SF32LB52
    help
      AW32001 charger, USB/VBUS detection and battery voltage monitoring
      through the SiFli GPADC.

config BATTERY_QEMU
    bool "QEMU Battery"
    default y if SOC_QEMU
    help
      Stub battery driver for QEMU (fixed values).

config BATTERY_STUB
    bool "Stub"
    help
      Fixed-value battery driver for board bring-up.

module = DRIVER_BATTERY
module-str = Battery
source "subsys/logging/Kconfig.template.log_level"

endif # BATTERY
```

## src/fw/drivers/display/Kconfig
```kconfig
# SPDX-FileCopyrightText: 2026 Core Devices LLC
# SPDX-License-Identifier: Apache-2.0

menuconfig DISPLAY
    bool "Display"
    help
      Display Drivers

if DISPLAY

config DISPLAY_JDI_SF32LB
    bool "JDI (SiFli SF32LB)"
    default y if SOC_SF32LB52
    select HAL_SIFLI
    select HAL_SIFLI_LCD
    help
      Support for JDI display via SiFli SF32LB.

config DISPLAY_CO5300_SF32LB
    bool "CO5300 AMOLED (SiFli SF32LB QSPI)"
    select HAL_SIFLI
    select HAL_SIFLI_LCD
    help
      Support for the CO5300 AMOLED panel through the SiFli LCDC QSPI
      four-data interface.

config DISPLAY_SHARP_LS013B7DH01_NRF5
    bool "Sharp LS013B7DH01 (nRF5)"
    default y if SOC_NRF52
    select HAL_NORDIC
    help
      Support for the Sharp LS013B7DH01 display via nRF5.

config DISPLAY_QEMU
    bool "QEMU Framebuffer Display"
    default y if SOC_QEMU
    help
      Support for the QEMU framebuffer display peripheral.

config DISPLAY_STUB
    bool "Stub display"
    help
      No-op display backend for board bring-up. The compositor and display
      services run normally, but no pixels are emitted.

module = DRIVER_DISPLAY
module-str = Display
source "subsys/logging/Kconfig.template.log_level"

endif # DISPLAY
```
